## main/Kconfig.projbuild
```kconfig
menu "MultiDisplay Configuration"

    # WiFi and location are normally set at runtime through the setup portal
    # (see README) and stored in NVS. The values below are only the seed
    # defaults: they pre-fill the portal form, and - if the SSID here is left
    # as the "myssid" placeholder - the device boots straight into the portal
    # on a fresh flash. Set a real SSID here to skip the portal and connect
    # immediately (the web page is then still reachable for later edits).

    config EXAMPLE_WIFI_SSID
        string "WiFi SSID (seed default)"
        default "myssid"
        help
            SSID (network name) to connect to. Leave as "myssid" to force the
            setup portal on first boot.

    config EXAMPLE_WIFI_PASSWORD
        string "WiFi password (seed default)"
        default "mypassword"
        help
            WiFi password (WPA/WPA2). Leave blank for an open network.

    config EXAMPLE_YR_LOCATION_NAME
        string "Forecast location name (seed default)"
        default "Oslo"
        help
            Human-readable name of the forecast location, shown on screen.
            The MET Norway locationforecast API returns only coordinates, so
            this label is configured rather than derived from the data.

    config EXAMPLE_YR_LATITUDE
        string "YR forecast latitude (seed default)"
        default "59.91"
        help
            Latitude passed to the MET Norway (yr.no) locationforecast API.
            Use at most 4 decimals.

    config EXAMPLE_YR_LONGITUDE
        string "YR forecast longitude (seed default)"
        default "10.75"
        help
            Longitude passed to the MET Norway (yr.no) locationforecast API.
            Use at most 4 decimals.

    config EXAMPLE_YR_USER_AGENT
        string "YR API User-Agent"
        default "MultiDisplay/1.0 (set-your-contact-here)"
        help
            api.met.no requires every client to identify itself with a
            descriptive User-Agent containing app name and contact info
            (e.g. a website or email). Requests with a missing or generic
            User-Agent are rejected with 403 Forbidden. Update this to
            identify yourself before using this outside of testing.
            A contact email entered on the setup page overrides this.
            See https://developer.yr.no/doc/TermsOfService/

    config MULTIDISPLAY_OTA_DEFAULT_URL
        string "Firmware update manifest URL (default)"
        default "http://192.168.0.119:8070/manifest.json"
        help
            Where the display looks for new firmware (see
            docs/auto-update-plan.md), until another URL is saved on the
            setup page. manifest-test.json next to it is the test channel.

    config MULTIDISPLAY_BOARD
        string "Board name, for firmware updates"
        default "esp32s3-lcd-4.3"
        help
            An update's manifest must name this board, so firmware for other
            hardware sharing the project name is never installed.

endmenu
```
